/* Copyright (c) 2013, The Linux Foundation. All rights reserved.
 *
 * This program is free software; you can redistribute it and/or modify
 * it under the terms of the GNU General Public License version 2 and
 * only version 2 as published by the Free Software Foundation.
 *
 * This program is distributed in the hope that it will be useful,
 * but WITHOUT ANY WARRANTY; without even the implied warranty of
 * MERCHANTABILITY or FITNESS FOR A PARTICULAR PURPOSE.  See the
 * GNU General Public License for more details.
 */

qcom,a51-id2-batterydata {
	qcom,fcc-mah = <2600>;
	qcom,batt-id-kohm = <22>;
	htc,voltage_max = <4350>;
	htc,capacity = <2600>;
	htc,batt_id = <2>;
	htc,id_raw_min = <205>;
	htc,id_raw_max = <500>;
	htc,type = <1>;
	htc,model_name = "B0PF6100";

	htc,vth-sf-lut {
		qcom,lut-col-legend = <3400 3431 3461 3487 3513 3536 3559 3582 3607 3632 3660 3688 3719 3751 3785 3823 3868 3914 3964 4029 4128>;
		qcom,lut-data = <0 5 10 15 20 25 30 35 40 45 50 55 60 65 70 75 80 85 90 95 100>;
	};

	htc,rbatt-temp-lut {
		qcom,lut-col-legend = <(-20) (-10) 0>;
		qcom,lut-data = <1060 640 375>;
	};
};
