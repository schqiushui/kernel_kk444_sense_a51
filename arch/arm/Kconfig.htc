## arch/arm/Kconfig.htc
```kconfig
comment "HTC Debugging Features"
menuconfig HTC_DEBUG
	bool "HTC Debugging Feature Switch"
	default y
	help
	  Enable collection of debug features.
	  This feature is enabled in defconfig.

comment "HTC features"
menuconfig HTC_FEATURES
        bool "HTC Implement Features"
        default n
        help
          Enable collection of HTC features.
          This feature is enabled in defconfig.

config HTC_FEATURES_FINAL_EFS_SYNC
	bool "Final EFS SYNC"
	depends on HTC_FEATURES
	default n
	help
	  Enable the trigger of final efs sync before shutdown/reboot
	  This feature is enabled in defconfig.

config HTC_FEATURES_SSR
       bool "HTC style ssr features"
       depends on HTC_FEATURES && MSM_SUBSYSTEM_RESTART
       default n
       help
         Say Y here if you want the HTC style ssr features

config HTC_FEATURES_SSR_MODEM_ENABLE
       bool "HTC style modem ssr features"
       depends on HTC_FEATURES_SSR
       default n
       help
         Say Y here if you want the HTC style for modem ssr features

config HTC_FEATURES_SSR_WCNSS_ENABLE
       bool "HTC style wcnss ssr features"
       depends on HTC_FEATURES_SSR
       default n
       help

config HTC_DEBUG_AUDIO
       bool "Trigger ramdump for audio error"
       default n
       depends on HTC_DEBUG
       help
         Say Y here if you want the HTC audio debug enable

config HTC_DEBUG_FOOTPRINT
       bool "Record footprint on some actions"
       default n
       depends on HTC_DEBUG
       help
         Record footprints for debug tracking.
         Especially for suspend/resume and boot.

config HTC_DEFAULT_ENABLED_FEATURES
	bool "Select default enabled config for HTC projects"
	default y
	select COMPACTION
	help
	  Default y to select other configs which should be enabled by default
	  for HTC projects.

config HTC_BUILD_EDIAG
        bool "Build in embedded diag fixes"
        default n
        help
          For embedded diag we need to do some additional fixes.

config ENLARGE_RADIO_BUFFER
        bool "Enlarge radio buffer"
        default n
        help
          Enlarge radio buffer for two rild project.

config HTC_RPM_CMD
	bool "HTC homebrew command interface"
	depends on MSM_RPM || MSM_RPM_SMD
	default n
	help
	  This expose HTC RPM command interface for different purpose.

config HTC_POWER_HACK
       bool "HTC POWER HACK"
       help
         Say Y here if HTC POWER HACK

config HTC_DEBUG_SSR
       bool "HTC style subsys restart debug features"
       depends on HTC_DEBUG && MSM_SUBSYSTEM_RESTART
       help
         Say Y here if you want the HTC style subsys restart debug features

config KSM_HTC_POLICY
	bool "Enable KSM by HTC strategy"
	depends on KSM
	help
	  Improve power drop impact when KSM is on.

config HTC_FEATURES_RIL_PCN0001_REBOOT_WITH_ERASE_EFS
       bool "Reboot with ERASE_EFS reason when SMSM_ERASE_EFS raised"
       default y
       help
         When modem met fatal,
         It will enable bit RESTART_MODE_ERASE_EFS.
         Then when device reboot, it will clean up EFS.

config HTC_DEBUG_RIL_PCN0002_DUMP_STACK
       bool "Dump call stack when modem crash"
       help
         Say Y here if you want dump call stack when modem crash

config HTC_FEATURES_RIL_PCN0003_HTC_MONITOR
	tristate "HTC_FEATURES_RIL_PCN0003_HTC_MONITOR"
	default n
	---help---
	  Come up with a way to add information of data usage in attribute file
	  for identifying the process that requested for data transmission.

config HTC_FEATURES_RIL_PCN0004_HTC_GARBAGE_FILTER
	tristate "HTC_FEATURES_RIL_PCN0004_HTC_GARBAGE_FILTER"
	default n
	depends on MSM_SMD
	---help---
	  Garbage Filter of TCP

config HTC_DEBUG_RIL_PCN0005_HTC_DUMP_SMSM_LOG
	tristate "HTC_DEBUG_RIL_PCN0005_HTC_DUMP_SMSM_LOG"
	default n
	depends on MSM_SMD
	---help---
	  Dump SMSM log message

config HTC_DEBUG_RIL_PCN0006_HTC_DUMP_BAM_DMUX_LOG
	tristate "HTC_DEBUG_RIL_PCN0006_HTC_DUMP_BAM_DMUX_LOG"
	default n
	depends on MSM_BAM_DMUX
	---help---
	  Dump BAM DMUX log message

config HTC_FEATURES_RIL_PCN0007_FINAL_EFS_SYNC
	tristate "HTC_DEBUG_RIL_PCN0007_FINAL_EFS_SYNC"
	default y
	---help---
	  Trigger modem EFS sync when device reboot
```

## drivers/htc_debug/stability/Kconfig
```kconfig
#
# HTC_DEBUG stability Kconfig
#

config HTC_DEBUG_KP
	default y
	depends on HTC_DEBUG
	bool "HTC style kernel panic debug features"
	help
	  Say Y here if you want the HTC style kernel panic debug features

config HTC_PROCESS_DEBUG
        bool "process/thread debug support"
        default y
        help
	  This option enables kernel debug log to check if any
          assigned process receives signal or unexpected exit

config HTC_DEBUG_SAVE_BOOT_MSG
	default y
	depends on HTC_DEBUG
	bool "HTC debug: saving kernel log of booting to memory"

config HTC_DEBUG_RTB
	default y
	depends on HTC_DEBUG && MSM_RTB
	bool "HTC style rtb debug features"
	help
	  Say Y here if you want the HTC style rtb debug features

config HTC_DEBUG_WORKQUEUE
	default y
	depends on HTC_DEBUG
	bool "HTC style workqueue debug features"
	help
	Say Y here if you want the HTC style workqueue debug features

config DIRTY_SYSTEM_DETECTOR
        default y
        bool "HTC dirty file detector for /system partition"

config HTC_DEBUG_BINDER_WRITE
	default n
	bool "HTC debug feature for system_server binder write"
	depends on HTC_DEBUG
	help
	  Say Y here if you want the HTC debug feature for system_server binder
	  write

config HTC_FD_MONITOR
	bool "fd operation monitor mechanism"
	default n

config HTC_DEBUG_DYING_PROCS
	default y
	bool "HTC debug feature for recording dying processes"
	depends on HTC_DEBUG
	help
	  This option enables the recording of latest 10 killed processes in
	  /proc/dying_processes

config HTC_DEBUG_VMALLOC_DUMP
	default y
	bool "HTC style vmalloc fail debug features"
	depends on HTC_DEBUG
	help
	  This option enables the dump for vmalloc info when vmalloc failed.
	  The same information could also be get under /proc/vmallocinfo

config HTC_DEBUG_HBRAMLOG
	bool "HTC style ram console debug features"
	default y
	depends on HTC_DEBUG && PSTORE_CONSOLE
	help
	  Say Y here if you want the HTC style ram console debug features

config SLUB_LIGHT_WEIGHT_DEBUG_ON
	bool "SLUB light weight debugging on by default"
	depends on SLUB && SLUB_DEBUG && SLUB_DEBUG_ON && !KMEMCHECK
	default n
	help
	  Light weight memory corruption debugging for slub. Only SLAB_STORE_USER
	  and SLAB_DEBUG_FREE was choosen.

config HTC_DEBUG_PAGE_USER_TRACE
	bool "Record call trace of page user in page structure"
	depends on PAGE_POISONING
	default n
	help
	  For debugging purpose, add call trace of user (freer and
	  allocator) to page structure

config HTC_DEBUG_PAGE_ENTRIES_NR
	int
	default 8

config HTC_INIT_COREDUMP
        depends on COREDUMP
        default n
        bool "HTC debug: enable coredump for INIT"
        help
          Enable COREDUMP for INIT.

config HTC_WFE_DISABLE
	default n
	bool "Disable WFE instruction to avoid CPU issue"
	help
	  Disable ARM wfe instruction which might cause CPU hang and trigger
	  watchdog reset.
```

## drivers/i2c/chips/Kconfig
```kconfig
#
# Miscellaneous I2C chip drivers configuration
#

menu "Miscellaneous I2C Chip support"

config TI_TCA6418
	tristate "TCA6418 GPIO expander support"
	depends on I2C=y
	help
	  If you say yes here you get support for Texas Instruments's
	  GPIO expander TCA6418.

config INPUT_CWSTM32
       tristate "CyWee CWSTM32 Sensor HUB"
       depends on I2C && INPUT
       select INPUT_POLLDEV
       help
         This driver provides support for CWSTM32 Sensor HUB.

config SENSORS_AK8963_DOE_PLUS
	tristate "AK8963 compass support with DOE Plus"
	default n
	depends on I2C
	help
	  If you say yes here you get support for Asahi Kasei's
	  orientation sensor with DOE Plus.


config BOSCH_BMA250
        tristate "BMA250 acceleration sensor support"
	depends on I2C=y
	help
	  If you say yes here you get support for Bosch Sensortec's
	  acceleration sensors BMA250.

config BOSCH_BMA250_ENABLE_INT1
	tristate "BMA250 acceleration sensor interrupt INT1 support"
	depends on BOSCH_BMA250=y
        help
	  If you say yes here you get INT1 support for Bosch Sensortec's
	  acceleration sensors BMA250.

config BOSCH_BMA250_ENABLE_INT2
	tristate "BMA250 acceleration sensor interrupt INT2 support"
	depends on BOSCH_BMA250=y
	help
	  If you say yes here you get INT2 support for Bosch Sensortec's
	  acceleration sensors BMA250.

config CIR_ALWAYS_READY
        bool "BMA250 CIR Always Ready"
	default n
	help
	  Enable CIR Always Ready

config KIONIX_KXTJ2
        tristate "KXTJ2 acceleration sensor support"
	depends on I2C=y
	help
	  If you say yes here you get support for Kionix Sensortec's
	  acceleration sensors KXTJ2.

config YAMAHA_YAS532
        tristate "YAS53x compass sensor support"
	depends on I2C=y
	help
	  If you say yes here you get support for Yamaha Sensortec's
	  acceleration sensors YAS532.

config SENSORS_NFC_PN544
	tristate "PN544 NFC sensor support"
	depends on I2C=y
	help
	PN544 NFC Driver implemented.

config SENSORS_NFC_IRQ_WORKAROUND
	tristate "PN544 NFC sensor IRQ workaround"
	depends on SENSORS_NFC_PN544=y
	help
	PN547 NFC Driver IRQ workaround.

config INPUT_CAPELLA_CM36686
        tristate "CM36686 proximity and light sensor"
        help
          Say Y here to enable the CM36686 Short Distance Proximity
          Sensor with Ambient Light Sensor.

config AMP_TFA9887
        tristate "NXP TFA9887 Speaker AMP Driver"
	depends on I2C=y
        help
         NXP TFA9887 Speaker AMP Driver implemented by HTC.

config AMP_TFA9887L
        tristate "NXP TFA9887L Speaker AMP Driver"
	depends on I2C=y
        help
         NXP TFA9887L Speaker AMP Driver implemented by HTC.

config AMP_TPA6130A2
        tristate "TI TPA6130A2 Headset AMP Driver"
	depends on I2C=y
        help
         TI TPA6130A2 Headset AMP Driver implemented by HTC.

config AMP_TPA2011
        tristate "TI TPA2011 Receiver AMP"
	default n
        help
         TI TPA2011 Receiver AMP control.

config SYNC_TOUCH_STATUS
        bool "Sync touch i2c switch status to sensor hub"
	default n
	help
	  Sync touch i2c switch status to sensor hub
endmenu
```

## drivers/misc/headset/Kconfig
```kconfig
config HTC_HEADSET
	tristate "HTC 2 Wire detection driver"
	default n
	help
	 Provides support for detecting HTC 2 wire devices, such as wired
	 headset, on the trout platform. Can be used with the msm serial
	 debugger, but not with serial console.

config HTC_HEADSET_MGR
	tristate "HTC headset manager driver"
	default n
	help
	  Provides support of HTC headset manager.

config HTC_HEADSET_GPIO
	tristate "HTC GPIO headset detection driver"
	depends on HTC_HEADSET_MGR
	default n
	help
	  Provides support of HTC GPIO headset detection.

config HTC_HEADSET_PMIC
	tristate "HTC PMIC headset detection driver"
	depends on HTC_HEADSET_MGR
	default n
	help
	  Provides support of HTC PMIC headset detection.

config HTC_HEADSET_ONE_WIRE
	tristate "HTC 1-wire headset detection driver"
	depends on HTC_HEADSET_MGR
	default n
	help
	  Provides support of HTC 1-wire headset detection.
```
